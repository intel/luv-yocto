## meta-luv/conf/distro/efitest.conf
```bitbake
DISTRO_NAME = "EFI Test Distribution"
DISTRO_VERSION = "1.0"

TCLIBCAPPEND = ""

PREFERRED_PROVIDER_virtual/kernel = "linux-yocto-efi-test"
```

## meta-luv/conf/distro/luv.conf
```bitbake
DISTRO_NAME = "Linux UEFI Validation Distribution"
DISTRO_VERSION = "2.3-dev"

TCLIBCAPPEND = ""

PREFERRED_PROVIDER_virtual/kernel = "linux-luv"
LINUXLIBCVERSION = "4.18"

LAYER_CONF_VERSION ?= "6"

PACKAGE_EXCLUDE = "busybox"

EFI_PROVIDER = "luv-efi"

DISTRO_FEATURES_append = " systemd"
VIRTUAL-RUNTIME_init_manager = "systemd"
VIRTUAL-RUNTIME_initscripts = ""
DISTRO_FEATURES_BACKFILL_CONSIDERED += "sysvinit"

INITRAMFS_MAXSIZE = "260000"
```

## meta-luv/conf/layer.conf
```bitbake
# We have a conf and classes directory, add to BBPATH
BBPATH =. "${LAYERDIR}:"

# We have recipes-* directories, add to BBFILES
BBFILES += "${LAYERDIR}/recipes-*/*/*.bb \
	${LAYERDIR}/recipes-*/*/*.bbappend"

BBFILE_COLLECTIONS += "luv"
BBFILE_PATTERN_luv = "^${LAYERDIR}/"
BBFILE_PRIORITY_luv = "6"

LAYERSERIES_COMPAT_luv = "sumo"
```

## meta/conf/machine/genericarmv8.conf
```bitbake
#@TYPE: Machine
#@NAME: generic armv8 machine
#@DESCRIPTION: generic machine

require conf/machine/include/arm64/arch-armv8.inc

# Don't include kernels in standard images
RDEPENDS_kernel-base = ""

PREFERRED_PROVIDER_virtual/kernel ?= "leg-kernel"

KERNEL_IMAGETYPE = "Image"

# we do not want to have getty running on tty1 as we run
# auto-serial-console there
USE_VT = "0"
```

## meta/conf/machine/genericarmv8b.conf
```bitbake
#@TYPE: Machine
#@NAME: generic armv8 big endian machine
#@DESCRIPTION: generic machine
DEFAULTTUNE = "aarch64_be"

require conf/machine/genericarmv8.conf
```
